## config/west.yml
```yaml
manifest:
  remotes:
    - name: urob
      url-base: https://github.com/urob
  projects:
    - name: zmk
      remote: urob
      revision: releases/v0.1+mouse
      import: app/west.yml
  self:
    path: config
```
